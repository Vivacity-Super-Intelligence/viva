## CMakeLists.txt
```
cmake_minimum_required(VERSION 3.20)
find_package(Zephyr REQUIRED HINTS $ENV{ZEPHYR_BASE})
project(viva VERSION 0.1.0 LANGUAGES C)
set(VIVA_ROOT "${CMAKE_CURRENT_LIST_DIR}/../../..")
target_sources(app PRIVATE src/main.c src/viva_hal_stm32.c
  "${VIVA_ROOT}/firmware/core/src/viva_core.c"
  "${VIVA_ROOT}/firmware/core/src/viva_protocol.c"
  "${VIVA_ROOT}/firmware/tests/viva_selftest.c"
  "${VIVA_ROOT}/firmware/tests/viva_osal_selftest.c"
  "${VIVA_ROOT}/firmware/hal/src/viva_runtime.c"
  "${VIVA_ROOT}/firmware/osal/zephyr/viva_osal.c")
target_include_directories(app PRIVATE "${VIVA_ROOT}/firmware/core/include" "${VIVA_ROOT}/firmware/hal/include" "${VIVA_ROOT}/firmware/osal/include" "${VIVA_ROOT}/firmware/tests")
target_compile_definitions(app PRIVATE VIVA_OSAL_ZEPHYR=1)
target_compile_features(app PRIVATE c_std_11)
if(DEFINED VIVA_BUILD_ID)
  target_compile_definitions(app PRIVATE VIVA_BUILD_ID="${VIVA_BUILD_ID}")
endif()
```

## prj.conf
```kconfig
CONFIG_SERIAL=y
CONFIG_CONSOLE=y
CONFIG_UART_CONSOLE=y
CONFIG_UART_INTERRUPT_DRIVEN=y
CONFIG_PRINTK=y
CONFIG_MAIN_STACK_SIZE=4096
CONFIG_WATCHDOG=y
CONFIG_REBOOT=y
CONFIG_THREAD_NAME=y
CONFIG_PICOLIBC=y
CONFIG_PICOLIBC_IO_LONG_LONG=y
```

## app.overlay
```dts
&iwdg {
    status = "okay";
};
```

## src/main.c
```c
#include "viva_hal.h"
int main(void) { viva_runtime_run(); return 0; }
```

## src/viva_hal_stm32.c
```c
#include "viva_hal.h"
#include "viva_osal.h"
#include <zephyr/drivers/uart.h>
#include <zephyr/sys/ring_buffer.h>
#include <zephyr/sys/atomic.h>
static const struct device *const console = DEVICE_DT_GET(DT_CHOSEN(zephyr_console));
RING_BUF_DECLARE(viva_rx, 256);
static atomic_t rx_overflow;
/* Single IRQ producer and single runtime consumer: ring_buf's SPSC contract. */
static void receive_irq(const struct device *dev, void *unused) {
    (void)unused;
    uart_irq_update(dev);
    while (uart_irq_rx_ready(dev)) {
        uint8_t bytes[16];
        int count = uart_fifo_read(dev, bytes, sizeof(bytes));
        if (count <= 0) { break; }
        if (ring_buf_put(&viva_rx, bytes, (uint32_t)count) != (uint32_t)count) { atomic_set(&rx_overflow, 1); }
    }
}
viva_error_t viva_hal_init(void) {
    if (!device_is_ready(console) || uart_irq_callback_user_data_set(console, receive_irq, NULL) != 0) { return VIVA_E_IO; }
    uart_irq_rx_enable(console); return VIVA_OK;
}
const char *viva_hal_platform(void) { return "nucleo_g491re"; }
viva_error_t viva_hal_write(const char *data, size_t len) {
    if (!data || !device_is_ready(console)) { return VIVA_E_IO; }
    for (size_t i = 0; i < len; ++i) { uart_poll_out(console, (unsigned char)data[i]); }
    return VIVA_OK;
}
viva_error_t viva_hal_read(char *byte) {
    if (!byte) { return VIVA_E_ARGUMENT; }
    if (atomic_set(&rx_overflow, 0)) { return VIVA_E_IO; }
    return ring_buf_get(&viva_rx, (uint8_t *)byte, 1) == 1u ? VIVA_OK : VIVA_E_TIMEOUT;
}
bool viva_hal_recovery_check(void) { return device_is_ready(console) && viva_os_watchdog_feed() == VIVA_OK; }
```
